/dts-v1/;
/plugin/;
#include <dt-bindings/clock/rk3588-cru.h>
#include <dt-bindings/gpio/gpio.h>
#include <dt-bindings/interrupt-controller/irq.h>
#include <dt-bindings/pinctrl/rockchip.h>
#include <dt-bindings/display/drm_mipi_dsi.h>

/ {
	compatible = "ayu,tspi-4m", "rockchip,rk3588";
};

#define MIPI_TX1_10P1_800X1280
#include "../tspi-4m-mipi-dsi1.dtsi"

&mipi_dcphy1 { status = "okay"; };
